WORKTASK Work[] = {
{ 0, { 0x56bbb62f,0x088069c4,0xa0227dc0,0x42f13516,0xc085e4e0,0x66778cb3,0xeaa7dbcb,0x9187b17a }, { 0x6bdb4426,0x51d4e757,0x1a00c94e } } ,
{ 1, { 0xc94826c3,0x0b2e66f1,0xc9eb1d2c,0x4032f869,0xb1bfa949,0xbdedf24f,0x6a31c0f6,0x0837f618 }, { 0x451b737e,0x51d4e763,0x1a00c94e } } ,
{ 2, { 0xc94826c3,0x0b2e66f1,0xc9eb1d2c,0x4032f869,0xb1bfa949,0xbdedf24f,0x6a31c0f6,0x0837f618 }, { 0x451b737e,0x51d4e763,0x1a00c94e } } ,
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{ 146, { 0xaa1557f4,0xcae58243,0x14770f2b,0x864c5aee,0xac3b8f4c,0x2611fa85,0x03781365,0x45bcf2ae }, { 0xc48895cc,0x51d50293,0x1a00c94e } } };
